## Config.in
```kconfig
source "$BR2_EXTERNAL_LICHEEPI_NANO_PATH/package/esp-hosted-nano/Config.in"
source "$BR2_EXTERNAL_LICHEEPI_NANO_PATH/package/modinstall/Config.in"
```

## board/licheepi_nano/linux/linux_defconfig
```kconfig
CONFIG_LOCALVERSION="-licheepi-nano"
# CONFIG_LOCALVERSION_AUTO is not set
CONFIG_NO_HZ=y
CONFIG_HIGH_RES_TIMERS=y
CONFIG_LOG_BUF_SHIFT=14
CONFIG_BLK_DEV_INITRD=y
CONFIG_CC_OPTIMIZE_FOR_SIZE=y
CONFIG_EXPERT=y
# CONFIG_IO_URING is not set
# CONFIG_KALLSYMS is not set
# CONFIG_ARCH_MULTI_V7 is not set
CONFIG_ARCH_SUNXI=y
CONFIG_AEABI=y
CONFIG_OABI_COMPAT=y
CONFIG_HIGHMEM=y
CONFIG_ARM_APPENDED_DTB=y
CONFIG_ARM_ATAG_DTB_COMPAT=y
CONFIG_CPU_FREQ=y
CONFIG_CPUFREQ_DT=y
CONFIG_CPU_IDLE=y
CONFIG_ARM_CPUIDLE=y
CONFIG_FPE_NWFPE=y
CONFIG_STRICT_KERNEL_RWX=y
# CONFIG_MQ_IOSCHED_KYBER is not set
# CONFIG_IOSCHED_BFQ is not set
CONFIG_SWAP=y
CONFIG_ZSMALLOC=y
CONFIG_ZRAM=y
CONFIG_ZRAM_BACKEND_LZ4=y
CONFIG_ZRAM_DEF_COMP_LZ4=y
CONFIG_NET=y
CONFIG_UNIX=y
# CONFIG_WIRELESS is not set
CONFIG_UEVENT_HELPER=y
CONFIG_DEVTMPFS=y
CONFIG_DEVTMPFS_MOUNT=y
CONFIG_SUNXI_RSB=y
CONFIG_INPUT_EVDEV=y
# CONFIG_KEYBOARD_ATKBD is not set
CONFIG_KEYBOARD_SUN4I_LRADC=y
# CONFIG_INPUT_MOUSE is not set
CONFIG_INPUT_MISC=y
# CONFIG_SERIO_SERPORT is not set
# CONFIG_VT is not set
CONFIG_SERIAL_8250=y
CONFIG_SERIAL_8250_CONSOLE=y
CONFIG_SERIAL_8250_NR_UARTS=8
CONFIG_SERIAL_8250_RUNTIME_UARTS=8
CONFIG_SERIAL_8250_DW=y
CONFIG_SERIAL_OF_PLATFORM=y
# CONFIG_HW_RANDOM is not set
CONFIG_I2C_CHARDEV=y
CONFIG_I2C_MV64XXX=y
CONFIG_PPS=y
CONFIG_POWER_SUPPLY=y
# CONFIG_HWMON is not set
CONFIG_THERMAL=y
CONFIG_CPU_THERMAL=y
CONFIG_WATCHDOG=y
CONFIG_SUNXI_WATCHDOG=y
CONFIG_MFD_AXP20X_I2C=y
CONFIG_MFD_AXP20X_RSB=y
CONFIG_REGULATOR=y
CONFIG_REGULATOR_FIXED_VOLTAGE=y
CONFIG_DRM=y
CONFIG_DRM_SUN4I=y
CONFIG_DRM_PANEL_SIMPLE=y
CONFIG_FB=y
CONFIG_FB_SIMPLE=y
CONFIG_FB_SSD1307=y
CONFIG_BACKLIGHT_CLASS_DEVICE=y
CONFIG_BACKLIGHT_PWM=y
CONFIG_SOUND=y
CONFIG_SND=y
CONFIG_SND_OSSEMUL=y
CONFIG_SND_MIXER_OSS=y
CONFIG_SND_PCM_OSS=y
# CONFIG_SND_VERBOSE_PROCFS is not set
CONFIG_SND_SOC=y
CONFIG_SND_SUN4I_CODEC=y
# CONFIG_HID_SUPPORT is not set
# the micro-USB port as a USB serial port for the Mac (/dev/ttyGS0 here, a getty on it):
# a faster console for copying than UART0. Device only, no USB host, no networking.
CONFIG_USB_SUPPORT=y
CONFIG_USB_MUSB_HDRC=y
CONFIG_USB_MUSB_GADGET=y
CONFIG_USB_MUSB_SUNXI=y
CONFIG_MUSB_PIO_ONLY=y
CONFIG_NOP_USB_XCEIV=y
CONFIG_PHY_SUN4I_USB=y
CONFIG_EXTCON=y
CONFIG_USB_GADGET=y
CONFIG_USB_G_SERIAL=y
CONFIG_MMC=y
CONFIG_MMC_SUNXI=y
CONFIG_NEW_LEDS=y
CONFIG_LEDS_CLASS=y
CONFIG_LEDS_GPIO=y
CONFIG_LEDS_TRIGGERS=y
CONFIG_LEDS_TRIGGER_HEARTBEAT=y
CONFIG_LEDS_TRIGGER_DEFAULT_ON=y
CONFIG_DMADEVICES=y
CONFIG_STAGING=y
# CONFIG_IOMMU_SUPPORT is not set
CONFIG_PWM=y
CONFIG_PWM_SUN4I=y
CONFIG_EXT4_FS=y
CONFIG_VFAT_FS=y
CONFIG_TMPFS=y
CONFIG_NLS_CODEPAGE_437=y
CONFIG_NLS_ISO8859_1=y
CONFIG_PRINTK_TIME=y
# (otherwise the kernel's code and data are each padded to whole megabytes, to protect them
# from each other: up to a megabyte or two of the 32 lost, for hardening this board doesn't need)
# CONFIG_STRICT_KERNEL_RWX is not set
# CONFIG_SLUB_DEBUG is not set
CONFIG_RCU_TRACE=y
# CONFIG_FTRACE is not set
```

## package/esp-hosted-nano/Config.in
```kconfig
config BR2_PACKAGE_ESP_HOSTED_NANO
	bool "esp-hosted-nano (WiFi through an ESP32 on SPI)"
	depends on BR2_LINUX_KERNEL
	select BR2_PACKAGE_WPA_SUPPLICANT
	select BR2_PACKAGE_WPA_SUPPLICANT_NL80211
	select BR2_PACKAGE_WPA_SUPPLICANT_CLI       # wpa_cli: Settings scans and joins networks with it
	help
	  WiFi for the Lichee Nano from an ESP32 running Espressif's
	  ESP-Hosted firmware, wired to SPI1 (see the board's device tree).
	  Builds the esp32_spi kernel module from esp-hosted-linux and
	  starts wlan0 at boot: wpa_supplicant (networks in
	  /etc/wpa_supplicant.conf), DHCP and network time.

	  (Named -nano: Buildroot has its own esp-hosted, from the older
	  espressif/esp-hosted repository, which isn't this firmware's driver.)

	  https://github.com/espressif/esp-hosted-linux
```

## package/esp-hosted/Config.in
```kconfig
config BR2_PACKAGE_ESP_HOSTED
	bool "esp-hosted (WiFi through an ESP32 on SPI)"
	depends on BR2_LINUX_KERNEL
	select BR2_PACKAGE_WPA_SUPPLICANT
	select BR2_PACKAGE_WPA_SUPPLICANT_NL80211
	select BR2_PACKAGE_WPA_SUPPLICANT_CLI       # wpa_cli: Settings scans and joins networks with it
	select BR2_PACKAGE_DROPBEAR                 # ssh and scp to the board
	help
	  WiFi for the Lichee Nano from an ESP32 running Espressif's
	  ESP-Hosted firmware, wired to SPI1 (see the board's device tree).
	  Builds the esp32_spi kernel module from esp-hosted-linux and
	  starts wlan0 at boot: wpa_supplicant (networks in
	  /etc/wpa_supplicant.conf), DHCP and network time.

	  https://github.com/espressif/esp-hosted-linux
```

## package/fbclock/Config.in
```kconfig
config BR2_PACKAGE_FBCLOCK
	bool "fbclock"
	depends on BR2_PACKAGE_PYTHON3
	select BR2_PACKAGE_PYTHON_PILLOW
	select BR2_PACKAGE_FREETYPE  # Pillow's text rendering
	select BR2_PACKAGE_DEJAVU    # the font the clock draws with
	help
	  Full-screen chess clock for the framebuffer: famous games replayed
	  on a chessboard beside a chess-clock case showing the time, with a
	  touch-screen settings page. Source in clock/ of this repository.

comment "fbclock needs python3"
	depends on !BR2_PACKAGE_PYTHON3
```

## package/fbvacation/Config.in
```kconfig
config BR2_PACKAGE_FBVACATION
	bool "fbvacation"
	depends on BR2_PACKAGE_PYTHON3
	depends on !BR2_PACKAGE_FBCLOCK  # both are the full-screen app started at boot
	select BR2_PACKAGE_ZLIB          # the theme's images are gzipped
	select BR2_PACKAGE_LIBFFI        # Python's ctypes, which loads the drawing library
	help
	  Full-screen vacation countdown for the framebuffer: a photo of the
	  ship at sea that follows the time of day, with cabin lights, a
	  rippling sea, smoke and fireworks, and a flip-clock of the days
	  left. The drawing is a small C library (libvacfx). Source in
	  vacation/ of this repository.

comment "fbvacation needs python3, and can't be built alongside fbclock"
	depends on !BR2_PACKAGE_PYTHON3 || BR2_PACKAGE_FBCLOCK
```

## package/modinstall/Config.in
```kconfig
config BR2_PACKAGE_MODINSTALL
	bool "modinstall (signed apps)"
	select BR2_PACKAGE_ZLIB
	help
	  Checks an app's Ed25519 signature against
	  the keys in /etc/modules/trusted.keys, and installs it into
	  /apps. See docs/apps.md.
```
